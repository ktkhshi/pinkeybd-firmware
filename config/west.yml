## config/west.yml
```yaml
manifest:
  remotes:
    - name: cormoran
      url-base: https://github.com/cormoran
    - name: zmkfirmware
      url-base: https://github.com/zmkfirmware
    - name: pinkeybd-firmware
      url-base: https://github.com/ktkhshi/pinkeybd-firmware
    - name: zephyrproject-rtos
      url-base: https://github.com/zephyrproject-rtos
    - name: ktkhshi
      url-base: https://github.com/ktkhshi
    - name: caksoylar
      url-base: https://github.com/caksoylar
  projects:
    - name: zmk
      remote: cormoran
      revision: main+dya
      import:
        file: app/west.yml
    - name: zephyr
      remote: cormoran
      revision: v4.1.0+zmk-fixes+nrf-half-duplex-uart
      clone-depth: 1
      import:
        name-blocklist:
          - ci-tools
          - hal_altera
          - hal_cypress
          - hal_infineon
          - hal_microchip
          - hal_nxp
          - hal_openisa
          - hal_silabs
          - hal_xtensa
          - hal_st
          - hal_ti
          - loramac-node
          - mcuboot
          - mcumgr
          - net-tools
          - openthread
          - edtt
          - trusted-firmware-m
    # Core modules required by DYA Studio's Custom Studio Protocol.
    # Dependencies such as nanopb and zmk-studio-messages are supplied by the
    # DYA-enabled ZMK manifest above, so their revisions stay in sync.
    - name: zmk-feature-custom-settings
      remote: cormoran
      revision: main
    - name: zmk-feature-fast-keymap
      remote: cormoran
      revision: main
    - name: zmk-driver-pmw3610-with-custom-studio-rpc
      remote: cormoran
      revision: main
    - name: zmk-module-ble-management
      remote: cormoran
      revision: main
    - name: zmk-module-battery-history
      remote: cormoran
      revision: main
    - name: zmk-module-settings-rpc
      remote: cormoran
      revision: main
    - name: zmk-module-runtime-input-processor
      remote: cormoran
      revision: main
    - name: zmk-rgbled-widget
      url: https://github.com/caksoylar/zmk-rgbled-widget
      revision: main
  self:
    west-commands: scripts/west-commands.yml
```
